## config/west.yml
```yaml
manifest:
  remotes:
    - name: zmkfirmware 
      url-base: https://github.com/zmkfirmware
    - name: MeowCatpawkittie
      url-base: https://github.com/MeowCatpawkittie
    - name: caksoylar
      url-base: https://github.com/caksoylar  
    - name: badjeff
      url-base: https://github.com/badjeff
    - name: cormoran
      url-base: https://github.com/cormoran

  projects:
    # 標準のZMKではなく、DYA Studio用のカスタムRPCが入ったcormoran版を指定
    - name: zmk
      remote: cormoran
      revision: v0.3-branch+dya
      import: app/west.yml

    # Pyuron既存の外部モジュール
    - name: zmk-pmw3610-driver
      remote: badjeff
      revision: main
    - name: zmk-rgbled-widget
      remote: caksoylar
      revision: main

    # --- ここからDYA Studioに必要なモジュールを追加 ---
    - name: zmk-module-ble-management
      remote: cormoran
      revision: main
    - name: zmk-module-battery-history
      remote: cormoran
      revision: main
    - name: zmk-module-settings-rpc
      remote: cormoran
      revision: main
    - name: zmk-module-runtime-input-processor
      remote: cormoran
      revision: main

  self:
    path: config
```
